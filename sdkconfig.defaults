## sdkconfig.defaults
```kconfig
# =============================================================
#  sdkconfig.defaults — loaded before any user sdkconfig
#  Design doc ref: §2, §9, §13
# =============================================================

# ── WiFi ──────────────────────────────────────────────────────
CONFIG_ESP_WIFI_STATIC_RX_BUFFER_NUM=16
CONFIG_ESP_WIFI_DYNAMIC_RX_BUFFER_NUM=32
CONFIG_ESP_WIFI_TX_BUFFER_TYPE_DYNAMIC=y
CONFIG_ESP32_WIFI_TASK_PINNED_TO_CORE_0=y

# ── TCP/IP stack ───────────────────────────────────────────────
CONFIG_LWIP_MAX_SOCKETS=16
CONFIG_LWIP_SO_RCVBUF=y

# ── WebSocket client ───────────────────────────────────────────
# esp_websocket_client is pulled via idf_component.yml as a
# managed component — no Kconfig enable needed in ESP-IDF 5.x

# ── RTOS / Task stacks ────────────────────────────────────────
# Main task stack — we spawn all tasks from app_main
CONFIG_ESP_MAIN_TASK_STACK_SIZE=8192

# ── Logging ───────────────────────────────────────────────────
CONFIG_LOG_DEFAULT_LEVEL_DEBUG=y
CONFIG_LOG_MAXIMUM_LEVEL_DEBUG=y

# ── I2S / Audio ───────────────────────────────────────────────
# APLL is configured at runtime via i2s_std_clk_config_t
# (clk_src = I2S_CLK_SRC_APLL) — no Kconfig needed
CONFIG_I2S_SUPPRESS_DEPRECATE_WARN=y

# ── FreeRTOS ──────────────────────────────────────────────────
# Tick rate: 1000 Hz gives 1ms resolution for our timing budget
CONFIG_FREERTOS_HZ=1000
CONFIG_FREERTOS_USE_TRACE_FACILITY=y

# ── Power / Flash ─────────────────────────────────────────────
CONFIG_ESPTOOLPY_FLASHSIZE_8MB=y
CONFIG_ESPTOOLPY_FLASHSIZE="8MB"
CONFIG_PARTITION_TABLE_SINGLE_APP_LARGE=y

# ── Compiler ──────────────────────────────────────────────────
# -O2 is enforced via build_flags in platformio.ini
CONFIG_COMPILER_OPTIMIZATION_PERF=y
```
